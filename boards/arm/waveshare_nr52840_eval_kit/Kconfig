## boards/arm/waveshare_nr52840_eval_kit/Kconfig
```kconfig
# WAVESHARE NRF52840 Eval Kit board configuration

# Copyright (c) 2022 Igor José Langer
# SPDX-License-Identifier: Apache-2.0

if BOARD_WAVESHARE_NRF52840_EVAL_KIT

config BOARD_ENABLE_DCDC
	bool "Enable DCDC mode"
	select SOC_DCDC_NRF52X
	default y

config BOARD_ENABLE_DCDC_HV
	bool "Enable High Voltage DCDC converter"
	select SOC_DCDC_NRF52X_HV
	default y

endif # BOARD_WAVESHARE_NRF52840_EVAL_KIT
```

## boards/arm/waveshare_nr52840_eval_kit/Kconfig.board
```kconfig
# Waveshare nRF52840 Eval Kit board configuration

# Copyright (c) 2022 Igor José Langer
# SPDX-License-Identifier: Apache-2.0

config BOARD_WAVESHARE_NRF52840_EVAL_KIT
	bool "Waveshare nRF52840 Eval Kit"
	depends on SOC_NRF52840_QIAA
```

## boards/arm/waveshare_nr52840_eval_kit/Kconfig.defconfig
```kconfig
# Waveshare nRF52840 Eval Kit board configuration

# Copyright (c) 2022 Igor José Langer
# SPDX-License-Identifier: Apache-2.0

if BOARD_WAVESHARE_NRF52840_EVAL_KIT

config BOARD
	default "waveshare_nrf52840_eval_kit"

endif # BOARD_WAVESHARE_NRF52840_EVAL_KIT
```
